## conf/layer.conf
```bitbake
# We have a conf and classes directory, add to BBPATH
BBPATH .= ":${LAYERDIR}"

# We have recipes-* directories, add to BBFILES
BBFILES += "${LAYERDIR}/recipes-*/*/*.bb \
            ${LAYERDIR}/recipes-*/*/*.bbappend"

BBFILE_COLLECTIONS += "meta-my-mender-rpi"
BBFILE_PATTERN_meta-my-mender-rpi = "^${LAYERDIR}/"
BBFILE_PRIORITY_meta-my-mender-rpi = "11"

LAYERDEPENDS_meta-my-mender-rpi = "core"
LAYERSERIES_COMPAT_meta-my-mender-rpi = "kirkstone"
```
